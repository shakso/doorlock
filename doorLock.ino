
#include <ESP8266WiFi.h>
#include <WiFiClient.h>
#include <ESP8266WebServer.h>
#include <ESP8266mDNS.h>
#include <EEPROM.h>
 

#include <GxEPD.h>
#include <GxGDEP015OC1/GxGDEP015OC1.cpp>
#include <Fonts/FreeSans18pt7b.h>
#include <Fonts/FreeSans24pt7b.h>
#include <GxIO/GxIO_SPI/GxIO_SPI.cpp>
#include <GxIO/GxIO.cpp>

GxIO_Class io(SPI, SS, 0, 2); // arbitrary selection of D3(=0), D4(=2), selected for default of GxEPD_Class
GxEPD_Class display(io); // default selection of D4(=2), D2(=4)

// Created by http://oleddisplay.squix.ch/ Consider a donation
// In case of problems make sure that you are using the font file with the correct version!
const uint8_t Lato_Black_80Bitmaps[] PROGMEM = {

  // Bitmap Data:
  0x00, // ' '
  0x7F,0xF9,0xFF,0xE7,0xFF,0x9F,0xFE,0x7F,0xF9,0xFF,0xE7,0xFF,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0x00, // '!'
  0xFF,0xE0,0xFF,0xFF,0xFC,0x1F,0xFF,0xFF,0x83,0xFF,0xFF,0xF0,0x7F,0xFF,0xFE,0x0F,0xFF,0xFF,0xC1,0xFF,0xFF,0xF8,0x3F,0xFF,0xFF,0x07,0xFF,0xFF,0xE0,0xFF,0xFF,0xFC,0x1F,0xFF,0xFF,0x83,0xFF,0xFF,0xF0,0x7F,0xFF,0xFE,0x0F,0xFE,0xFF,0xC0,0xFF,0xDF,0xF8,0x1F,0xFB,0xFE,0x03,0xFE,0x7F,0xC0,0x7F,0xCF,0xF8,0x0F,0xF8,0xFF,0x00,0xFF,0x1F,0xE0,0x1F,0xE1,0xF8,0x01,0xF8,0x1E,0x00,0x1E,0x00, // '"'
  0x00,0x00,0xFF,0x01,0xFE,0x00,0x00,0x07,0xFC,0x07,0xFC,0x00,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0x00, // '#'
  0x00,0x00,0x01,0xF8,0x00,0x00,0x00,0x00,0xFE,0x00,0x00,0x00,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0x00, // '$'
  0x00,0x04,0x00,0x00,0x00,0x00,0x00,0x00,0x07,0xFF,0x00,0x00,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0x00, // '%'
  0x00,0x00,0x00,0x40,0x00,0x00,0x00,0x00,0x00,0x1F,0xFF,0x00,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0xE0, // '&'
  0xFF,0xFF,0xFF,0xFF,0xFF,0xFF,0xFF,0xFF,0xFF,0xFF,0xFF,0xFF,0xFF,0xFF,0xFF,0xFF,0xFF,0xFE,0xFF,0xDF,0xFB,0xFE,0x7F,0xCF,0xF8,0xFF,0x1F,0xE1,0xF8,0x1E,0x00, // '''
  0x00,0x18,0x00,0x07,0x80,0x00,0xFC,0x00,0x3F,0xE0,0x0F,0xFC,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0x00, // '('
  0x03,0x00,0x03,0xC0,0x03,0xF8,0x01,0xFE,0x00,0xFF,0xC0,0x3F,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0x00, // ')'
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  0x00,0x00,0x80,0x00,0x00,0x3F,0xFF,0x00,0x00,0x7F,0xFF,0xF0,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0x00, // '?'
  0x00,0x00,0x00,0x1F,0xFC,0x00,0x00,0x00,0x00,0x00,0x07,0xFF,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0x00, // '@'
  0x00,0x00,0x03,0xFF,0xF8,0x00,0x00,0x00,0x00,0x00,0x7F,0xFF,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0xFC, // 'A'
  0xFF,0xFF,0xFF,0xF0,0x00,0x07,0xFF,0xFF,0xFF,0xFC,0x00,0x3F,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0x00, // 'B'
  0x00,0x00,0x00,0x04,0x00,0x00,0x00,0x00,0x01,0xFF,0xFE,0x00,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0x00, // 'C'
  0xFF,0xFF,0xFF,0xF0,0x00,0x00,0x07,0xFF,0xFF,0xFF,0xFC,0x00,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0x00, // 'D'
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  0xFF,0xF8,0x00,0x00,0x1F,0xFF,0x00,0x00,0x03,0xFF,0xE0,0x00,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0xFC, // 'L'
  0xFF,0xF8,0x00,0x00,0x00,0x00,0x0F,0xFF,0xFF,0xFE,0x00,0x00,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0xC0, // 'M'
  0xFF,0xC0,0x00,0x00,0x01,0xFF,0xFF,0xFC,0x00,0x00,0x00,0x3F,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0xFC, // 'N'
  0x00,0x00,0x00,0x02,0x00,0x00,0x00,0x00,0x00,0x00,0x1F,0xFF,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0x00, // 'O'
  0xFF,0xFF,0xFF,0xE0,0x00,0x0F,0xFF,0xFF,0xFF,0xE0,0x00,0xFF,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0x00, // 'P'
  0x00,0x00,0x00,0x02,0x00,0x00,0x00,0x00,0x00,0x00,0x03,0xFF,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0xFF, // 'Q'
  0xFF,0xFF,0xFF,0xC0,0x00,0x01,0xFF,0xFF,0xFF,0xF8,0x00,0x03,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0xFC, // 'R'
  0x00,0x00,0x02,0x00,0x00,0x00,0x00,0xFF,0xFE,0x00,0x00,0x01,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0x00, // 'S'
  0xFF,0xFF,0xFF,0xFF,0xFF,0xFF,0xFF,0xFF,0xFF,0xFF,0xFF,0xFF,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0x00, // 'T'
  0xFF,0xF8,0x00,0x00,0x0F,0xFF,0xFF,0xFE,0x00,0x00,0x03,0xFF,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0x00, // 'U'
  0xFF,0xF8,0x00,0x00,0x00,0x03,0xFF,0xEF,0xFF,0x80,0x00,0x00,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0x00, // 'V'
  0xFF,0xFC,0x00,0x00,0x01,0xFE,0x00,0x00,0x00,0xFF,0xFB,0xFF,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0x00, // 'W'
  0x7F,0xFF,0x80,0x00,0x00,0x3F,0xFF,0x1F,0xFF,0xE0,0x00,0x00,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0xC0, // 'X'
  0xFF,0xFC,0x00,0x00,0x00,0x3F,0xFF,0x7F,0xFE,0x00,0x00,0x00,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0x00, // 'Y'
  0x3F,0xFF,0xFF,0xFF,0xFF,0xFC,0xFF,0xFF,0xFF,0xFF,0xFF,0xF3,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0xE0, // 'Z'
  0xFF,0xFF,0xFF,0xFF,0xFF,0xFF,0xFF,0xFF,0xFF,0xFF,0xFF,0xFF,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0xFC, // '['
  0xFF,0x00,0x00,0x00,0x1F,0xF0,0x00,0x00,0x07,0xFE,0x00,0x00,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0xFC, // '\'
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  0xFE,0x00,0x07,0xFF,0x00,0x3F,0xFC,0x01,0xFF,0xF8,0x0F,0xFF,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0x80,0x00 // '}'
};
const GFXglyph Lato_Black_80Glyphs[] PROGMEM = {
// bitmapOffset, width, height, xAdvance, xOffset, yOffset
    {     0,   1,   1,  19,    0,    0 }, // ' '
    {     1,  14,  58,  24,    5,  -58 }, // '!'
    {   103,  27,  22,  34,    3,  -58 }, // '"'
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    { 23683,  21,  75,  26,    2,  -62 } // '}'
};
const GFXfont Lato_Black_80 PROGMEM = {
(uint8_t  *)Lato_Black_80Bitmaps,(GFXglyph *)Lato_Black_80Glyphs,0x20, 0x7E, 96};
const char* ssid = "56brw";
const char* password = "xxx";
int pin;
int unlock=0;

ESP8266WebServer server(80);


void handleRoot() {
  if (server.hasArg("pin") == true) {
    if (server.arg("pin") != "") {
      if (server.arg("pin") == String(pin)) {
        server.send(200, "text/html", "OK");
        unlock=1;
      } else {
        server.send(200, "text/html", "NOPE");  
      }
    }
  } else {
    server.send(200, "text/html", "<html><head><script src='https://ajax.googleapis.com/ajax/libs/jquery/3.2.1/jquery.min.js'></script></head><body style='text-align:center; align:center; font-family:monospace;'><h1>Door</h1><input id='theBox' type='tel' maxlength='4' size='4' autofocus style='font-size:3em;'><script language='Javascript'>$(document).ready(function(){ $('input#theBox').keyup(function() {var theBox = $(this);if (theBox.val().length == 4) {theBox.css({'background-color':'#ffff00'});$.get( '/?pin=' + theBox.val(), function( data ) { if (data.includes('OK')) { theBox.css({'background-color':'#00ff00'});} else { theBox.css({'background-color':'#ff0000'});}});}});});</script></body></html>");
  }
   
  return;
}

void showDisplay() {  
  display.fillScreen(GxEPD_WHITE);
  display.setTextColor(GxEPD_BLACK);
  display.setFont(&FreeSans18pt7b);
  display.setCursor(22,60);
  display.println("Frontdoor");
  display.setFont(&Lato_Black_80);
  display.setCursor(4,138);
  display.println(pin);
  display.update();
}

void resetPin() {
  pin=random(1000,9999);
  EEPROM.put(0,pin);
  EEPROM.commit();
  showDisplay();
  server.send(200, "text/html","OK");
  return;
}

void setup() {
  
  pinMode(D0, OUTPUT); 
  
  Serial.begin(57600);

  WiFi.hostname("doorlock");
  WiFi.begin(ssid, password);
  Serial.println("");
  
  // Wait for connection
  while (WiFi.status() != WL_CONNECTED) {
    delay(500);
    Serial.print(".");
  }
  Serial.println("");
  Serial.print("Connected to ");
  Serial.println(ssid);
  Serial.print("IP address: ");
  Serial.println(WiFi.localIP());
  
  if (MDNS.begin("esp8266")) {
  Serial.println("MDNS responder started");
  }
  
  server.on("/", handleRoot);
  server.on("/resetpin", resetPin);
  server.begin();

  display.init();

  EEPROM.begin(512);
  EEPROM.get(0,pin);

  if ((pin > 9999) || (pin == 0)) {
    pin=random(1000,9999);
    EEPROM.put(0,pin);
    EEPROM.commit();
  }

  showDisplay();
  
}


void loop() {
    server.handleClient();
    if (unlock == 1) {
      digitalWrite(D0, HIGH);
      delay(2000);
      digitalWrite(D0, LOW);
      unlock=0;
    }
    
}
